## configs/nuc970_defconfig
```kconfig
CONFIG_ARM=y
CONFIG_TARGET_NUC970=y
CONFIG_BOOTDELAY=3
CONFIG_HUSH_PARSER=y
# CONFIG_CMD_IMLS is not set
# CONFIG_CMD_FLASH is not set
# CONFIG_CMD_SETEXPR is not set
# CONFIG_DM_SERIAL is not set
```
